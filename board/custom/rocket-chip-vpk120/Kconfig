## board/custom/rocket-chip-vpk120/Kconfig
```kconfig
if TARGET_ROCKET_CHIP_VPK120

config SYS_BOARD
	default "rocket-chip-vpk120"

config SYS_VENDOR
	default "custom"

config SYS_CPU
	default "generic"

config SYS_CONFIG_NAME
	default "rocket-chip-vpk120"

config TEXT_BASE
	default 0x800040000

config BOARD_SPECIFIC_OPTIONS # dummy
	def_bool y
	select GENERIC_RISCV
	imply SMP
	imply BOARD_LATE_INIT
	imply DM_SERIAL

endif
```

## configs/rocket-chip-vpk120_defconfig
```kconfig
CONFIG_RISCV=y
CONFIG_NR_DRAM_BANKS=1
CONFIG_ENV_SIZE=0x20000
CONFIG_TARGET_ROCKET_CHIP_VPK120=y
CONFIG_ARCH_RV64I=y

CONFIG_HAS_CUSTOM_SYS_INIT_SP_ADDR=y
CONFIG_CUSTOM_SYS_INIT_SP_ADDR=0x820000000

# Linux
CONFIG_SYS_LOAD_ADDR=0x800100000
# 64MB for image.itb
CONFIG_SYS_BOOTM_LEN=0x4000000

CONFIG_FIT=y
CONFIG_DISPLAY_CPUINFO=y
CONFIG_DISPLAY_BOARDINFO=y
CONFIG_SYS_RELOC_GD_ENV_ADDR=y
CONFIG_DM_MTD=y

# reduce image size
CONFIG_BLK=n
CONFIG_MTD=n
CONFIG_DISTRO_DEFAULTS=n
CONFIG_REGEX=n
CONFIG_EFI_LOADER=n
CONFIG_PARTITIONS=n
CONFIG_CMD_NFS=n
CONFIG_CMD_CRC32=n
CONFIG_CMD_LZMADEC=n
CONFIG_CMD_UNLZ4=n
CONFIG_CMD_UNZIP=n
CONFIG_FIT_FULL_CHECK=n
CONFIG_FIT_ENABLE_SHA256_SUPPORT=n
CONFIG_GZIP=n
CONFIG_SHA256=n
CONFIG_DM_MMC=n
CONFIG_CMD_LOADB=n
CONFIG_CMD_FDT=n
CONFIG_CRC32=n
CONFIG_BOOTMETH_DISTRO=n
CONFIG_PXE_UTILS=n
CONFIG_BOOTMETH_VBE=n
CONFIG_NET=n
CONFIG_ETH=n
CONFIG_I2C=n
CONFIG_GPIO=n

# run in s-mode as payload of opensbi
CONFIG_RISCV_SMODE=y
CONFIG_SYS_TEXT_BASE=0x800040000

# early debug uart
CONFIG_XILINX_UARTLITE=y
CONFIG_DEBUG_UART=y
CONFIG_DEBUG_UART_UARTLITE=y
CONFIG_DEBUG_UART_CLOCK=100000000
CONFIG_DEBUG_UART_BASE=0x40610000

# use dtb from OpenSBI
CONFIG_OF_BOARD=y
CONFIG_DEFAULT_DEVICE_TREE="rocket-chip-vpk120"
```

## generated_defconfig
```kconfig
# 0 "./arch/../configs/rocket-chip-vpk120_defconfig"
# 0 "<built-in>"
# 0 "<command-line>"
# 1 "./arch/../configs/rocket-chip-vpk120_defconfig"
CONFIG_RISCV=y
CONFIG_NR_DRAM_BANKS=1
CONFIG_ENV_SIZE=0x20000
CONFIG_TARGET_ROCKET_CHIP_VPK120=y
CONFIG_ARCH_RV64I=y
#CONFIG_FIT=y
CONFIG_DISPLAY_CPUINFO=y
CONFIG_DISPLAY_BOARDINFO=y
CONFIG_CMD_BOOTEFI_SELFTEST=y
CONFIG_CMD_NVEDIT_EFI=y
CONFIG_OF_PRIOR_STAGE=y
CONFIG_DM_MTD=y

CONFIG_HAS_CUSTOM_SYS_INIT_SP_ADDR=y
CONFIG_CUSTOM_SYS_INIT_SP_ADDR=0xa0000000
CONFIG_SYS_MALLOC_LEN=0x800000
CONFIG_SYS_LOAD_ADDR=0x80000000
CONFIG_SYS_RELOC_GD_ENV_ADDR=y
CONFIG_SYS_MAX_FLASH_BANKS=2

# reduce image size
CONFIG_BLK=n
CONFIG_NET=n
CONFIG_MTD=n
CONFIG_DISTRO_DEFAULTS=n
CONFIG_FS_EXT4=n
CONFIG_FS_FAT=n
CONFIG_REGEX=n
CONFIG_EFI_LOADER=n
CONFIG_PARTITIONS=n
CONFIG_CMD_NFS=n
CONFIG_CMD_CRC32=n
CONFIG_CMD_LZMADEC=n
CONFIG_CMD_UNLZ4=n
CONFIG_CMD_UNZIP=n

# early debug uart
CONFIG_DEBUG_UART=y
CONFIG_DEBUG_UART_NS16550=y
CONFIG_DEBUG_UART_CLOCK=100000000
CONFIG_DEBUG_UART_BASE=0x60001000
CONFIG_DEBUG_UART_SHIFT=2
CONFIG_BAUDRATE=115200

# use embedded dtb
CONFIG_OF_EMBED=y
CONFIG_DEFAULT_DEVICE_TREE="rocket-chip-vpk120"
```
